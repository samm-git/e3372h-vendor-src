## vender/config/product/hi6921_v711_e5578/os/acore/balongv7r2_defconfig
```kconfig
CONFIG_CPU_FREQ=y
CONFIG_GENERIC_GPIO=y
CONFIG_GENERIC_CLOCKEVENTS=y
# CONFIG_ARM_PATCH_PHYS_VIRT is not set
CONFIG_PHYS_OFFSET=0x54B00000
CONFIG_EXPERIMENTAL=y
# CONFIG_LOCALVERSION_AUTO is not set
CONFIG_SYSVIPC=y
CONFIG_IKCONFIG=y
CONFIG_IKCONFIG_PROC=y
CONFIG_CGROUPS=y
CONFIG_CGROUP_DEBUG=y
CONFIG_CGROUP_FREEZER=y
CONFIG_CGROUP_CPUACCT=y
CONFIG_RESOURCE_COUNTERS=y
CONFIG_CGROUP_SCHED=y
# CONFIG_FAIR_GROUP_SCHED is not set
CONFIG_RT_GROUP_SCHED=y
CONFIG_NAMESPACES=y
# CONFIG_UTS_NS is not set
# CONFIG_IPC_NS is not set
# CONFIG_USER_NS is not set
# CONFIG_PID_NS is not set
CONFIG_RELAY=y
CONFIG_BLK_DEV_INITRD=y
CONFIG_RD_BZIP2=y
CONFIG_RD_LZMA=y
CONFIG_KALLSYMS_ALL=y
CONFIG_EMBEDDED=y
CONFIG_PROFILING=y
CONFIG_OPROFILE=y
CONFIG_CPU_V7=y
CONFIG_PERF_EVENTS=y
CONFIG_HAVE_OPROFILE=y
CONFIG_HAVE_HW_BREAKPOINT=y
CONFIG_MODULES=y
CONFIG_MODULE_UNLOAD=y
CONFIG_MODULE_FORCE_UNLOAD=y
CONFIG_PARTITION_ADVANCED=y
CONFIG_ARM_ERRATA_754322=y


CONFIG_SERIAL_BALONGV7R2_UART=y 
CONFIG_SERIAL_BALONGV7R2_UART_CONSOLE=y

CONFIG_DECOMPRESS_GZIP=y

# CONFIG_MSM_STACKED_MEMORY is not set

# CONFIG_MSM_FIQ_SUPPORT is not set
# CONFIG_MSM_PROC_COMM is not set
CONFIG_ARCH_HI6930=y
CONFIG_ARCH_V711=y
CONFIG_GPIO_PCA953X=y
CONFIG_MSM_DIRECT_SCLK_ACCESS=y
CONFIG_NO_HZ=y
CONFIG_HIGH_RES_TIMERS=y
CONFIG_GENERIC_CLOCKEVENTS_BUILD=y
CONFIG_ARM_ARCH_TIMER=y
CONFIG_PREEMPT=y
CONFIG_AEABI=y
CONFIG_OABI_COMPAT=y
CONFIG_VMALLOC_RESERVE=0x19000000
CONFIG_USE_OF=y
#CONFIG_ARM_APPENDED_DTB=y
#CONFIG_ARM_ATAG_DTB_COMPAT=y
# CONFIG_CORE_DUMP_DEFAULT_ELF_HEADERS is not set


#wangshufeng:enable wext for iw
CONFIG_WLAN=y
CONFIG_BCM_FLWCTL=y
CONFIG_WLAN_BCM_CHIP=y
CONFIG_WIRELESS=y
CONFIG_WIRELESS_EXT=y
CONFIG_WEXT_CORE=y
CONFIG_WEXT_PROC=y
CONFIG_WEXT_PRIV=y
CONFIG_BALONG_WIFI=y
CONFIG_MTD=y
CONFIG_MTD_PARTITIONS=y
CONFIG_MTD_CMDLINE_PARTS=y
CONFIG_MTD_OF_PARTS=y
CONFIG_MTD_CHAR=y
CONFIG_MTD_BLKDEVS=y
CONFIG_MTD_BLOCK=y

CONFIG_MTD_NAND_IDS=y
CONFIG_MTD_NAND_ECC=y
CONFIG_MTD_NAND=y
CONFIG_MTD_NAND_BALONG_NANDC=y

# CONFIG_MTD_MSM_NAND is not set
CONFIG_MTD_MSM_QPIC_NAND=y
CONFIG_NET=y
CONFIG_PACKET=y
CONFIG_UNIX=y
CONFIG_INET=y
CONFIG_IPV6=y

CONFIG_BALONG_TRACE_KFREE_SKB=y

# netfilter configuration
CONFIG_NETFILTER=y
CONFIG_NETFILTER_NETLINK=y
CONFIG_NF_CONNTRACK=y
CONFIG_NF_CONNTRACK_PROCFS=y
CONFIG_NF_CONNTRACK_FTP=y
CONFIG_NF_CT_NETLINK=y
CONFIG_NETFILTER_XTABLES=y
CONFIG_NETFILTER_XT_MARK=y

CONFIG_NETFILTER_XT_MATCH_CONNTRACK=y
CONFIG_NETFILTER_XT_MATCH_POLICY=y
CONFIG_NETFILTER_XT_MATCH_STATE=y

CONFIG_NF_DEFRAG_IPV4=y
CONFIG_NF_CONNTRACK_IPV4=y
CONFIG_NF_CONNTRACK_PROC_COMPAT=y
CONFIG_IP_NF_IPTABLES=y
CONFIG_IP_NF_FILTER=y
CONFIG_IP_NF_TARGET_REJECT=y
CONFIG_IP_NF_TARGET_ULOG=y
CONFIG_NF_NAT=y
CONFIG_NF_NAT_NEEDED=y
CONFIG_IP_NF_TARGET_MASQUERADE=y
CONFIG_NF_NAT_FTP=y
CONFIG_IP_NF_MANGLE=y




# CONFIG_WIRELESS is not set
CONFIG_BLK_DEV_LOOP=y
#Begin: DTS2014110706582 added by w00249966 20141107
CONFIG_BLK_DEV_LOOP_MIN_COUNT=8
CONFIG_CUSE=y
CONFIG_ISO9660_FS=y
CONFIG_JOLIET=y
#End: DTS2014110706582 added by w00249966 20141107
CONFIG_BLK_DEV_RAM=y
# CONFIG_ANDROID_PMEM is not set

#
# SCSI device support
#
CONFIG_SCSI_MOD=y
CONFIG_SCSI=y
CONFIG_SCSI_DMA=y
CONFIG_SCSI_PROC_FS=y

#
# SCSI support type (disk, tape, CD-ROM)
#
CONFIG_BLK_DEV_SD=y
CONFIG_SCSI_MULTI_LUN=y
CONFIG_SCSI_CONSTANTS=y
CONFIG_SCSI_LOGGING=y
CONFIG_SCSI_WAIT_SCAN=m

#
# SCSI Transports
#
CONFIG_SCSI_LOWLEVEL=y
CONFIG_NETDEVICES=y
# CONFIG_NET_VENDOR_BROADCOM is not set
# CONFIG_NET_VENDOR_CIRRUS is not set
# CONFIG_NET_VENDOR_FARADAY is not set
# CONFIG_NET_VENDOR_INTEL is not set
# CONFIG_NET_VENDOR_MICROCHIP is not set
# CONFIG_MSM_RMNET is not set
# CONFIG_NET_VENDOR_NATSEMI is not set
# CONFIG_NET_VENDOR_SEEQ is not set
# CONFIG_NET_VENDOR_SMSC is not set
# CONFIG_NET_VENDOR_STMICRO is not set

# Input device support
#
CONFIG_INPUT=y

CONFIG_INPUT_EVDEV=y
#Begin:E5产品内存裁剪掉mouse设备,迁基线请注意不要覆盖(g00175336)
CONFIG_INPUT_EVBUG=n
CONFIG_INPUT_MOUSE=n
CONFIG_INPUT_MOUSEDEV=n
#End:E5产品内存裁剪掉mouse设备,迁基线请注意不要覆盖(g00175336)
#
# Input Device Drivers
#
CONFIG_INPUT_KEYBOARD=y
CONFIG_BALONG_KEYBOARD_GPIO=y
CONFIG_KEYBOARD_ATKBD=y
CONFIG_INPUT_MISC=y
CONFIG_INPUT_UINPUT=y
CONFIG_INPUT_GPIO=m
# CONFIG_LEGACY_PTYS is not set
CONFIG_SERIAL_MSM_HSL=y
CONFIG_SERIAL_MSM_HSL_CONSOLE=y
CONFIG_HW_RANDOM=y

CONFIG_OF_I2C=y
CONFIG_I2C=y
CONFIG_I2C_BOARDINFO=y
CONFIG_I2C_COMPAT=y
CONFIG_I2C_HELPER_AUTO=y
CONFIG_I2C_DESIGNWARE=y
CONFIG_I2C_DESIGNWARE_HI6930=y

CONFIG_SPI=n
CONFIG_SPI_QUP=n
CONFIG_SPI_BALONG=n
CONFIG_SPI_SPIDEV=n

CONFIG_ARCH_WANT_OPTIONAL_GPIOLIB=y
CONFIG_GPIOLIB=y
CONFIG_GPIO_SYSFS=y
CONFIG_DEBUG_GPIO=n
CONFIG_GPIO_BALONG=y
# CONFIG_HWMON is not set
CONFIG_REGULATOR=y
CONFIG_REGULATOR_DUMMY=n
CONFIG_REGULATOR_VIRTUAL_CONSUMER=y
CONFIG_REGULATOR_USERSPACE_CONSUMER=y
CONFIG_REGULATOR_BALONG=y
# CONFIG_SND_SOC_BALONG is not set
CONFIG_SND_SOC_I2C_AND_SPI=n
CONFIG_SND_SOC_ALL_CODECS=n
CONFIG_SND_SOC_WM_HUBS=n

CONFIG_SND_SOC_WM8990=n

# CONFIG_SOUND_PRIME is not set
# CONFIG_HID_SUPPORT is not set
# CONFIG_USB_SUPPORT is not set
CONFIG_USB_ARCH_HAS_XHCI=y
CONFIG_USB_SUPPORT=y
CONFIG_USB_COMMON=y
CONFIG_USB_ARCH_HAS_HCD=y
CONFIG_USB=y
CONFIG_USB_DEBUG=y
CONFIG_USB_ANNOUNCE_NEW_DEVICES=y

CONFIG_USB_DEVICE_CLASS=y
#/*BEGIN PN:DTS2013113005958,Modifed by w84014342, 2013/12/24*/
CONFIG_USB_SUSPEND=y
CONFIG_USB_OTG=y
CONFIG_USB_OTG_DWC=y
CONFIG_USB_OTG_VBUS_BYCHARGER=y
#/*END PN:DTS2013113005958,Modifed by w84014342, 2013/12/24*/
CONFIG_USB_OTG_USBID_BYGPIO=n
CONFIG_USB_DWC3=y
CONFIG_USB_DWC3_DEBUG=y
CONFIG_DWC3_DBG=y
CONFIG_USB_DWC3_VERBOSE=y
CONFIG_DWC3_INTERRUPT_GATHER=n
CONFIG_USB_DWC3_FORCE_DEVICE=y
#CONFIG_USB_DWC3_FORCE_HOST=y
CONFIG_USB_CDC_NCM_DWC_CACHE_TRB_NUM=16

#
# USB Host Controller Drivers
#
CONFIG_USB_XHCI_HCD=y
CONFIG_USB_XHCI_PLATFORM=y
CONFIG_USB_XHCI_HCD_DEBUGGING=y
#
# also be needed; see USB_STORAGE Help for more info
#
CONFIG_USB_STORAGE=y
CONFIG_USB_STORAGE_DEBUG=y
CONFIG_USB_UAS=y
CONFIG_USB_GADGET=y
CONFIG_USB_GADGET_DEBUG=y
CONFIG_USB_GADGET_DEBUG_FILES=y
CONFIG_USB_GADGET_DEBUG_FS=y
CONFIG_USB_GADGET_VBUS_DRAW=2
CONFIG_USB_GADGET_STORAGE_NUM_BUFFERS=2
CONFIG_USB_GADGET_DUALSPEED=y
CONFIG_USB_GADGET_SUPERSPEED=y
CONFIG_USB_BALONG_UDC=y
#huangfuli support rndis E5
#CONFIG_ETH_BYPASS_MODE=n
# CONFIG_NCM_TEST_SUPPORT is not set
# CONFIG_NCM_MBIM_SUPPORT is not set
CONFIG_BALONG_GNET=y
#CONFIG_BALONG_NCM=y
#CONFIG_USB_FSG=y
CONFIG_BALONG_ECM=y
CONFIG_BALONG_RNDIS=y
CONFIG_GNET_DEBUG=y
CONFIG_GNET_PREALLOC_RX_MEM=y
CONFIG_GNET_PREALLOC_TX_MEM=y
CONFIG_USB_OTG_UTILS=y
CONFIG_USB_CHARGER_DETECT=y
CONFIG_USB_PMU_DETECT=y

CONFIG_SPS=y
CONFIG_SPS_SUPPORT_BAMDMA=y

#HSIC DRIVER
CONFIG_USB_DWC=y
CONFIG_USB_GADGET_SNPS_DWC_OTG=y
CONFIG_USB_DWC_OTG_LPM=y
CONFIG_HSIC_NO_WAKEUP_PMU=y

CONFIG_MMC=n
CONFIG_MMC_V711=n
CONFIG_MMC_DEBUG=n
#CONFIG_MMC_CLKGATE=y
CONFIG_MMC_BLOCK=n
CONFIG_MMC_BLOCK_MINORS=8
CONFIG_MMC_BLOCK_BOUNCE=n
CONFIG_MMC_UNSAFE_RESUME=n
CONFIG_MMC_TEST=n
CONFIG_MMC_MSHCI=n
CONFIG_MMC_MSHCI_BALONG=n
CONFIG_MMC_EMBEDDED_SDIO=n
CONFIG_MMC_MSHCI_USE_HOLD_REG=n
CONFIG_MMC_ADP=n
CONFIG_GPIO_EXPANDER_BALONG=y
CONFIG_IOS_BALONG=y
CONFIG_EFUSE_BALONG=y
CONFIG_TEMPERATURE_SYS_BALONG=y
CONFIG_FUSE_FS=y
CONIFG_CUSE=y
CONFIG_HOTPLUG=y
CONFIG_SDIO_ARASAN=n
CONFIG_SDIO_ARASAN_DEBUG=n
#BEGIN DTS2013061307804  w00170782 2013/07/24 modified
CONFIG_WLAN_IF=y
#END DTS2013061307804  w00170782 2013/07/24 modified
CONFIG_SPS_SUPPORT_NDP_BAM=y

CONFIG_MISC_FILESYSTEMS=y
CONFIG_PROC_FS=y
CONFIG_VFAT_FS=y
CONFIG_TMPFS=y
CONFIG_YAFFS_FS=y
CONFIG_YAFFS_YAFFS2=y
CONFIG_YAFFS_AUTO_YAFFS2=y
CONFIG_YAFFS_DISABLE_TAGS_ECC=y
CONFIG_YAFFS_XATTR=y
CONFIG_BALONG_EARLY_FS=y
CONFIG_JFFS2_FS=y
CONFIG_JFFS2_FS_DEBUG=0
CONFIG_JFFS2_FS_WRITEBUFFER=y
CONFIG_JFFS2_WBUF_VERIFY=y
CONFIG_JFFS2_SUMMARY=y
CONFIG_JFFS2_FS_XATTR=y
CONFIG_JFFS2_FS_POSIX_ACL=y
CONFIG_JFFS2_FS_SECURITY=y
CONFIG_JFFS2_COMPRESSION_OPTIONS=y
CONFIG_JFFS2_ZLIB=y
CONFIG_JFFS2_LZO=y
CONFIG_JFFS2_RTIME=y
CONFIG_JFFS2_RUNBIN=y
CONFIG_JFFS2_CMODE_NONE=y
CONFIG_JFFS2_CMODE_FAVOURLZO=y
# CONFIG_BALONG_EARLY_FS_TEST is not set
CONFIG_NLS_CODEPAGE_437=y
CONFIG_NLS_ASCII=y
CONFIG_NLS_ISO8859_1=y
##/* BEGIN PN: DTS2013071704632, Added by h00122846, 2012/07/17 */
CONFIG_NLS_UTF8=y
CONFIG_FAT_FS=y
CONFIG_FAT_DEFAULT_IOCHARSET="utf8"
##/* END PN: DTS2013071704632, Added by h00122846, 2012/07/17 */
CONFIG_PRINTK_TIME=y
CONFIG_MAGIC_SYSRQ=y
CONFIG_DEBUG_FS=y
# CONFIG_SCHED_DEBUG is not set
CONFIG_DEBUG_KERNEL=y
CONFIG_TIMER_STATS=y
# CONFIG_DEBUG_PREEMPT is not set
CONFIG_DEBUG_INFO=y
CONFIG_IMAGE_LOAD=y
CONFIG_ICC_BALONG=y
CONFIG_ICC_BALONG_TEST=n
CONFIG_EDMA_SUPPORT=y
CONFIG_EDMA_TEST=y
CONFIG_BALONG_OAM_PS=y
CONFIG_UDI_SUPPORT=y
CONFIG_NVIM=y
CONFIG_NVIM_TEST=y
CONFIG_DEBUG_MEMORY_INIT=y
CONFIG_DYNAMIC_DEBUG=y
CONFIG_DEBUG_USER=y
CONFIG_KEYS=y
#Begin:E5产品内存裁剪掉crypto,迁基线请注意不要覆盖(g00175336)
CONFIG_CRYPTO_AUTHENC=n
CONFIG_CRYPTO_CBC=n
CONFIG_CRYPTO_HMAC=n
CONFIG_CRYPTO_MD4=n
CONFIG_CRYPTO_MD5=n
CONFIG_CRYPTO_SHA1=n
CONFIG_CRYPTO_SHA256=n
CONFIG_CRYPTO_AES=n
CONFIG_CRYPTO_ARC4=n
CONFIG_CRYPTO_DES=n
CONFIG_CRYPTO_TWOFISH=n
CONFIG_CRYPTO_DEFLATE=n
#End:E5产品内存裁剪掉crypto,迁基线请注意不要覆盖(g00175336)
# CONFIG_CRYPTO_HW is not set
CONFIG_CRC_CCITT=y
CONFIG_LIBCRC32C=y
CONFIG_WATCHDOG=y
CONFIG_HI6930_WATCHDOG=y
# nobody use it now
CONFIG_DPM_BALONG=y
CONFIG_HI6930_CSHELL=y
CONFIG_BALONG_RTC=n
CONFIG_HI6551_RTC=n
CONFIG_HI6559_RTC=y
CONFIG_RTC_CLASS=y
CONFIG_BALONG_RTC_TEST=y
CONFIG_MEM_BALONG=y
CONFIG_HARD_TIMER=y
CONFIG_HARD_TIMER_TEST=y
CONFIG_TIMER_ADP=y
CONFIG_RFILE_SUPPORT=y
CONFIG_RFILE_TEST=y
CONFIG_SOFT_TIMER=y
CONFIG_SOFT_TIMER_TEST=y
CONFIG_BUSSTRESS=n

# Graphics support
CONFIG_FB=y
CONFIG_LEDS_CLASS=y
CONFIG_NEW_LEDS=y
#support EMI for E5 
CONFIG_EMI_SUPPORT=n
#euap support
CONFIG_LEDS_GPIO=n
CONFIG_LEDS_TRIGGER_TIMER=n
CONFIG_LEDS_TRIGGERS=n
CONFIG_LEDS_BALONG=n
CONFIG_LEDS_TRIGGER_BREATH=n

CONFIG_IPC_DRIVER=y
CONFIG_IPC_TEST=y
CONFIG_IPC_ADP=y

#Pcie support
CONFIG_PCI=n
CONFIG_PCI_MSI=n
CONFIG_PCI_SYSCALL=n
CONFIG_PCIEPORTBUS=n
CONFIG_BALONG_PCIE=n
CONFIG_BALONG_PCIE_PM=n
CONFIG_BALONG_PCIE_L1SS=n
CONFIG_BALONG_PCIE_OUTPUT_CLK=n
CONFIG_BALONG_PCIE_FORCE_GEN1=n
CONFIG_BALONG_PCIE_TEST=n
CONFIG_PCIEASPM=n
CONFIG_PCIEASPM_DEFAULT=n
CONFIG_PCIEASPM_POWERSAVE=n
CONFIG_PCIEASPM_PERFORMANCE=n
CONFIG_PCIEASPM_DEBUG=n
CONFIG_PCIE_PME=n
CONFIG_PCIEAER=n
CONFIG_BALONG_PCIE_DOCKING_TEST=n
CONFIG_PCI_DEBUG=n

CONFIG_HW_IP_BASE_ADDR=y
#clk
CONFIG_BALONG_CLK=y

CONFIG_CHARGE_ADP=y
#
# Power management options
#
CONFIG_PM=y
CONFIG_PM_SLEEP=y
CONFIG_PM_RUNTIME=n
CONFIG_SUSPEND=y
CONFIG_HAVE_CPU_IDLE=y
CONFIG_HAS_WAKELOCK=y
CONFIG_WAKELOCK=y
CONFIG_WAKELOCK_STAT=y
CONFIG_USER_WAKELOCK=y
CONFIG_EARLYSUSPEND=y
CONFIG_BALONG_PM_SUSPEND=y

# E5 feature config
CONFIG_POWER_SUPPLY=y
#CONFIG_POWER_SUPPLY_DEBUG is not set
# sync
CONFIG_SYNC_BALONG=y

# ONOFF
CONFIG_BALONG_ONOFF=y
CONFIG_BALONG_MODEM_BOOT=y

#PMIC
CONFIG_PMIC=y
CONFIG_POWER_PMIC_HI6451=n
CONFIG_POWER_PMIC_HI6551=n
CONFIG_POWER_PMIC_HI6559=y


#coul
CONFIG_HI6551_COUL=n

#DSP
CONFIG_DSP_BALONG=y

#HKADC
CONFIG_HKADC_BALONG=y
#sec check
CONFIG_KDF_HASH=n
CONFIG_SEC_CHECK=n

#PWM
CONFIG_PWM=n
CONFIG_PWM_BALONG=n
CONFIG_LEDS_PWM_BALONG=n
CONFIG_FRAME_WARN=2048
#gmac
CONFIG_ETHERNET=n
CONFIG_NET_VENDOR_STMICRO=n
CONFIG_STMMAC_ETH=n
CONFIG_STMMAC_RING=n
CONFIG_STMMAC_PLATFORM=n
CONFIG_STMMAC_DEBUG_FS=n
#CONFIG_GMAC_TEST=y
CONFIG_PHYLIB=n
CONFIG_EMU_MODE=n

#VFP
CONFIG_VFP=y
CONFIG_VFPv3=y

#at dialup hsuart
CONFIG_M2M_HSUART=n

# efuse
#
# efuse balong driver
#
CONFIG_EFUSE_BALONG_ADP=y
#BEGIN DTS2013061307804  s00201037 2013/06/024 modified
#
# Networking options
#
CONFIG_MICROSTATE_ACCT=y
CONFIG_HISI_SOCKET=y
CONFIG_PACKET=y
CONFIG_UNIX=y
# CONFIG_NET_KEY is not set
CONFIG_INET=y
CONFIG_IP_MULTICAST=y
# CONFIG_IP_ADVANCED_ROUTER is not set
CONFIG_IP_FIB_HASH=y
#begin:E5内存裁剪掉TCP/IP协议栈部分特性，迁基线注意不要覆盖<g00175336>
CONFIG_IP_PNP=n
CONFIG_IP_PNP_DHCP=n
CONFIG_IP_PNP_BOOTP=n
CONFIG_IP_PNP_RARP=n
# CONFIG_NET_IPIP is not set
# CONFIG_NET_IPGRE is not set
CONFIG_IP_MROUTE=y
CONFIG_IP_PIMSM_V1=n
CONFIG_IP_PIMSM_V2=n
# CONFIG_ARPD is not set
CONFIG_SYN_COOKIES=n
#end:E5内存裁剪掉TCP/IP协议栈部分特性，迁基线注意不要覆盖<g00175336>
# CONFIG_INET_AH is not set
# CONFIG_INET_ESP is not set
# CONFIG_INET_IPCOMP is not set
# CONFIG_INET_XFRM_TUNNEL is not set
# CONFIG_INET_TUNNEL is not set
# CONFIG_INET_XFRM_MODE_TRANSPORT is not set
# CONFIG_INET_XFRM_MODE_TUNNEL is not set
# CONFIG_INET_XFRM_MODE_BEET is not set
CONFIG_INET_LRO=y
CONFIG_INET_DIAG=y
CONFIG_INET_TCP_DIAG=y
# CONFIG_TCP_CONG_ADVANCED is not set
CONFIG_TCP_CONG_CUBIC=y
CONFIG_DEFAULT_TCP_CONG="cubic"
# CONFIG_TCP_MD5SIG is not set

#/*modified for E5776s-860 begin */
CONFIG_IPV6=y
# CONFIG_IPV6_PRIVACY is not set
#begin:E5内存裁剪掉TCP/IP协议栈部分特性，迁基线注意不要覆盖<g00175336>
CONFIG_IPV6_ROUTER_PREF=n
# CONFIG_IPV6_ROUTE_INFO is not set
# CONFIG_IPV6_OPTIMISTIC_DAD is not set
# CONFIG_INET6_AH is not set
# CONFIG_INET6_ESP is not set
# CONFIG_INET6_IPCOMP is not set
# CONFIG_IPV6_MIP6 is not set
# CONFIG_INET6_XFRM_TUNNEL is not set
CONFIG_INET6_TUNNEL=n
# CONFIG_INET6_XFRM_MODE_TRANSPORT is not set
# CONFIG_INET6_XFRM_MODE_TUNNEL is not set
# CONFIG_INET6_XFRM_MODE_BEET is not set
# CONFIG_INET6_XFRM_MODE_ROUTEOPTIMIZATION is not set
CONFIG_IPV6_SIT=n
CONFIG_IPV6_SIT_6RD=n
CONFIG_IPV6_NDISC_NODETYPE=y
CONFIG_IPV6_TUNNEL=n
#end:E5内存裁剪掉TCP/IP协议栈部分特性，迁基线注意不要覆盖<g00175336>
CONFIG_IPV6_MULTIPLE_TABLES=y
CONFIG_IPV6_SUBTREES=y
# CONFIG_IPV6_MROUTE is not set
#/*modified for E5776s-860 end */

CONFIG_ANDROID_PARANOID_NETWORK=y
CONFIG_NET_ACTIVITY_STATS=y
# CONFIG_NETWORK_SECMARK is not set
CONFIG_NETFILTER=y
# CONFIG_NETFILTER_DEBUG is not set
CONFIG_NETFILTER_ADVANCED=y
CONFIG_BRIDGE_NETFILTER=n

#
# Core Netfilter Configuration
#
CONFIG_NETFILTER_NETLINK=y
# CONFIG_NETFILTER_NETLINK_LOG is not set
CONFIG_NF_CONNTRACK=y
CONFIG_NF_CT_ACCT=y
CONFIG_NF_CONNTRACK_MARK=y
CONFIG_NF_CONNTRACK_EVENTS=y
CONFIG_NF_CT_PROTO_DCCP=y
CONFIG_NF_CT_PROTO_GRE=y
CONFIG_NF_CT_PROTO_SCTP=y
CONFIG_NF_CT_PROTO_UDPLITE=y
# CONFIG_NF_CONNTRACK_AMANDA is not set
CONFIG_NF_CONNTRACK_FTP=y
CONFIG_NF_CONNTRACK_H323=y
CONFIG_NF_CONNTRACK_IRC=y
CONFIG_NF_CONNTRACK_PPTP=y
# CONFIG_NF_CONNTRACK_SANE is not set
# CONFIG_NF_CONNTRACK_SIP is not set
CONFIG_NF_CONNTRACK_TFTP=y
CONFIG_NF_CONNTRACK_RTSP=y
CONFIG_NF_CT_NETLINK=y
CONFIG_NETFILTER_XTABLES=y

#
# Xtables combined modules
#
CONFIG_NETFILTER_XT_MARK=y
#
# Xtables targets
#
# CONFIG_NETFILTER_XT_TARGET_CLASSIFY is not set
# CONFIG_NETFILTER_XT_TARGET_DSCP is not set
CONFIG_NETFILTER_XT_TARGET_HL=y
CONFIG_NETFILTER_XT_TARGET_MARK=y
# CONFIG_NETFILTER_XT_TARGET_NFLOG is not set
CONFIG_NETFILTER_XT_TARGET_NFQUEUE=y
# CONFIG_NETFILTER_XT_TARGET_NOTRACK is not set
CONFIG_NETFILTER_XT_TARGET_RATEEST=y
# CONFIG_NETFILTER_XT_TARGET_TEE is not set
# CONFIG_NETFILTER_XT_TARGET_TRACE is not set
CONFIG_NETFILTER_XT_TARGET_TCPMSS=y
# CONFIG_NETFILTER_XT_TARGET_TCPOPTSTRIP is not set

#
# Xtables matches
#
# CONFIG_NETFILTER_XT_MATCH_CLUSTER is not set
# CONFIG_NETFILTER_XT_MATCH_COMMENT is not set
# CONFIG_NETFILTER_XT_MATCH_CONNBYTES is not set
CONFIG_NETFILTER_XT_MATCH_CONNLIMIT=y
CONFIG_NETFILTER_XT_MATCH_CONNMARK=y
CONFIG_NETFILTER_XT_MATCH_CONNTRACK=y
# CONFIG_NETFILTER_XT_MATCH_DCCP is not set
# CONFIG_NETFILTER_XT_MATCH_DSCP is not set
# CONFIG_NETFILTER_XT_MATCH_ESP is not set
CONFIG_NETFILTER_XT_MATCH_HASHLIMIT=y
# CONFIG_NETFILTER_XT_MATCH_HELPER is not set
CONFIG_NETFILTER_XT_MATCH_HL=y
CONFIG_NETFILTER_XT_MATCH_IPRANGE=y
# CONFIG_NETFILTER_XT_MATCH_LENGTH is not set
CONFIG_NETFILTER_XT_MATCH_LIMIT=y
# CONFIG_NETFILTER_XT_MATCH_MAC is not set
CONFIG_NETFILTER_XT_MATCH_MARK=y
CONFIG_NETFILTER_XT_MATCH_MULTIPORT=y
# CONFIG_NETFILTER_XT_MATCH_OSF is not set
# CONFIG_NETFILTER_XT_MATCH_OWNER is not set
# CONFIG_NETFILTER_XT_MATCH_PHYSDEV is not set
# CONFIG_NETFILTER_XT_MATCH_PKTTYPE is not set
# CONFIG_NETFILTER_XT_MATCH_QUOTA is not set
CONFIG_NETFILTER_XT_MATCH_RATEEST=y
# CONFIG_NETFILTER_XT_MATCH_REALM is not set
# CONFIG_NETFILTER_XT_MATCH_RECENT is not set
# CONFIG_NETFILTER_XT_MATCH_SCTP is not set
CONFIG_NETFILTER_XT_MATCH_STATE=y
# CONFIG_NETFILTER_XT_MATCH_STATISTIC is not set
CONFIG_NETFILTER_XT_MATCH_STRING=y
CONFIG_NETFILTER_XT_MATCH_TCPMSS=y
# CONFIG_NETFILTER_XT_MATCH_TIME is not set
CONFIG_NETFILTER_XT_MATCH_U32=y
CONFIG_NETFILTER_XT_MATCH_DNS_FLT=y
CONFIG_IP_VS=y
# CONFIG_IP_VS_DEBUG is not set
CONFIG_IP_VS_TAB_BITS=12
#
# IP: Netfilter Configuration
#
CONFIG_SYSCTL=y
CONFIG_NF_DEFRAG_IPV4=y
CONFIG_NF_CONNTRACK_IPV4=y
CONFIG_NF_CONNTRACK_PROC_COMPAT=y
CONFIG_IP_NF_QUEUE=y
CONFIG_IP_NF_IPTABLES=y
CONFIG_IP_NF_MATCH_ADDRTYPE=y
CONFIG_IP_NF_MATCH_AH=y
CONFIG_IP_NF_MATCH_ECN=y
CONFIG_IP_NF_MATCH_TTL=y
CONFIG_IP_NF_MATCH_WEBSTR=y
CONFIG_IP_NF_FILTER=y
CONFIG_IP_NF_TARGET_REJECT=y
# CONFIG_IP_NF_TARGET_LOG is not set
# CONFIG_IP_NF_TARGET_ULOG is not set
CONFIG_NF_NAT=y
CONFIG_NF_NAT_NEEDED=y
CONFIG_IP_NF_TARGET_MASQUERADE=y
CONFIG_IP_MASQUERADE_SYMMNAT=y
CONFIG_IP_NF_TARGET_NETMAP=y
CONFIG_IP_NF_TARGET_REDIRECT=y
CONFIG_NF_NAT_SNMP_BASIC=y
CONFIG_NF_NAT_PROTO_DCCP=y
CONFIG_NF_NAT_PROTO_GRE=y
CONFIG_NF_NAT_PROTO_UDPLITE=y
CONFIG_NF_NAT_PROTO_SCTP=y
CONFIG_NF_NAT_FTP=y
CONFIG_NF_NAT_IRC=y
CONFIG_NF_NAT_TFTP=y
CONFIG_NF_NAT_PPTP=y
CONFIG_NF_NAT_H323=y
# CONFIG_NF_NAT_SIP is not set
CONFIG_NF_NAT_RTSP=y
CONFIG_IP_NF_MANGLE=y
CONFIG_IP_NF_TARGET_ECN=y
CONFIG_IP_NF_TARGET_TTL=y
CONFIG_IP_NF_RAW=y
CONFIG_IP_NF_ARPTABLES=y
CONFIG_IP_NF_ARPFILTER=y
CONFIG_IP_NF_ARP_MANGLE=y
#/*modified for E5776s-860 begin */
#
# IPv6: Netfilter Configuration
#
CONFIG_NF_CONNTRACK_IPV6=y
CONFIG_IP6_NF_QUEUE=y
CONFIG_IP6_NF_IPTABLES=y
CONFIG_IP6_NF_MATCH_AH=y
CONFIG_IP6_NF_MATCH_EUI64=y
CONFIG_IP6_NF_MATCH_FRAG=y
CONFIG_IP6_NF_MATCH_OPTS=y
#CONFIG_IP6_NF_MATCH_HL=y
CONFIG_IP6_NF_MATCH_IPV6HEADER=y
CONFIG_IP6_NF_MATCH_MH=y
CONFIG_IP6_NF_MATCH_RT=y
CONFIG_IP6_NF_TARGET_HL=y
CONFIG_IP6_NF_TARGET_LOG=y
CONFIG_IP6_NF_FILTER=y
CONFIG_IP6_NF_TARGET_REJECT=y
CONFIG_IP6_NF_MANGLE=y
CONFIG_IP6_NF_RAW=y
#/*modified for E5776s-860 begin */

# CONFIG_IP_DCCP is not set
# CONFIG_IP_SCTP is not set
# CONFIG_RDS is not set
# CONFIG_TIPC is not set
# CONFIG_ATM is not set
CONFIG_L2TP=y
CONFIG_STP=y
CONFIG_BRIDGE=y
# CONFIG_BRIDGE_IGMP_SNOOPING is not set
# CONFIG_VLAN_8021Q is not set
# CONFIG_DECNET is not set
CONFIG_LLC=y
# CONFIG_LLC2 is not set
# CONFIG_IPX is not set
# CONFIG_ATALK is not set
# CONFIG_X25 is not set
# CONFIG_LAPB is not set
# CONFIG_ECONET is not set
# CONFIG_WAN_ROUTER is not set
# CONFIG_PHONET is not set
# CONFIG_IEEE802154 is not set
# CONFIG_NET_SCHED is not set
CONFIG_DCB=y

#
# Network testing
#
# CONFIG_NET_PKTGEN is not set
# CONFIG_HAMRADIO is not set
# CONFIG_CAN is not set
# CONFIG_IRDA is not set
# CONFIG_BT is not set
# CONFIG_AF_RXRPC is not set
CONFIG_HW_RMNET=y
CONFIG_WIRELESS=y
CONFIG_WIRELESS_EXT=y
CONFIG_WEXT_CORE=y
CONFIG_WEXT_PROC=y
CONFIG_WEXT_SPY=y
CONFIG_WEXT_PRIV=y
# CONFIG_CFG80211 is not set
CONFIG_WIRELESS_EXT_SYSFS=y
#begin:E5内存裁剪掉TCP/IP协议栈部分特性，迁基线注意不要覆盖<g00175336>
CONFIG_LIB80211=n
#end:E5内存裁剪掉TCP/IP协议栈部分特性，迁基线注意不要覆盖<g00175336>
CONFIG_LIB80211_CRYPT_WEP=y
CONFIG_LIB80211_CRYPT_CCMP=y
CONFIG_LIB80211_CRYPT_TKIP=y
# CONFIG TC QOS add shaolei begin
CONFIG_NET_SCHED=y
CONFIG_NET_SCH_CBQ=y
CONFIG_NET_SCH_HTB=y
CONFIG_NET_SCH_PRIO=y
CONFIG_NET_SCH_SFQ=y
CONFIG_NET_CLS=y
CONFIG_NET_CLS_BASIC=y
CONFIG_NET_CLS_ROUTE4=y
CONFIG_NET_CLS_ROUTE=y
CONFIG_NET_CLS_FLOW=y
CONFIG_NET_SCH_FIFO=y
CONFIG_NETFILTER_NETLINK=y
CONFIG_NETFILTER_NETLINK_QUEUE=y
CONFIG_NETFILTER_NETLINK_LOG=y
CONFIG_NF_CT_NETLINK=y
CONFIG_SCSI_NETLINK=y
CONFIG_IP_ADVANCED_ROUTER=y
NET_SCH_INGRESS=y
CONFIG_NET_CLS_U32=y
CONFIG_CLS_U32_PERF=y
CONFIG_CLS_U32_MARK=y
CONFIG_NET_CLS_FW=y
# CONFIG TC QOS add shaolei end
# CONFIG EBTABLES add shaolei begin
CONFIG_BRIDGE_NF_EBTABLES=y
CONFIG_BRIDGE_NETFILTER=y
CONFIG_NETFILTER_XTABLES=y
CONFIG_BRIDGE_EBT_BROUTE=y
CONFIG_BRIDGE_EBT_T_FILTER=y
CONFIG_BRIDGE_EBT_T_NAT=y
CONFIG_BRIDGE_EBT_802_3=y
CONFIG_BRIDGE_EBT_AMONG=y
CONFIG_BRIDGE_EBT_ARP=y
CONFIG_BRIDGE_EBT_IP=y
CONFIG_BRIDGE_EBT_IP6=y
CONFIG_BRIDGE_EBT_LIMIT=y
CONFIG_BRIDGE_EBT_MARK=y
CONFIG_BRIDGE_EBT_PKTTYPE=y
CONFIG_BRIDGE_EBT_STP=y
CONFIG_BRIDGE_EBT_VLAN=y
CONFIG_BRIDGE_EBT_ARPREPLY=y
CONFIG_BRIDGE_EBT_DNAT=y
CONFIG_BRIDGE_EBT_MARK_T=y
CONFIG_BRIDGE_EBT_REDIRECT=y
CONFIG_BRIDGE_EBT_SNAT=y
CONFIG_BRIDGE_EBT_LOG=y
CONFIG_BRIDGE_EBT_ULOG=y
CONFIG_BRIDGE_EBT_NFLOG=y
# CONFIG EBTABLES add shaolei end
#END DTS2013061307804  s00201037 2013/06/024 modified

# 强制门户
CONFIG_PRSITE=y
#add multi_talbes and multipath verbose for multi wan
CONFIG_IP_MULTIPLE_TABLES=y
CONFIG_IP_ROUTE_MULTIPATH=y
```
