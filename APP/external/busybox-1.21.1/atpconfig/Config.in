## vender/modem/system/android/android_4.2_r1/kernel/drivers/fastOnOff/Kconfig
```kconfig
config FAST_ON_OFF
	bool "FAST_ON_OFF Support"
	default y
	help
	  Say Y to enable Linux FAST_ON_OFF support.  This allows the E5 is 
	  started within 5 seconds.
```

## vender/modem/system/android/android_4.2_r1/kernel/drivers/huawei/Kconfig
```kconfig
config MBB_MLOG_DRV
	tristate "mobilelog driver"
	default n
	help
	  mobilelog driver

config MBB_MLOG_DRV_TEST
	tristate "mobilelog driver test"
	default n
	help
	  mobilelog driver test
	  
config MBB_DLOAD
	tristate "huaweidload driver"
	default n
	help
	  huaweidload driver test
```

## vender/modem/system/android/android_4.2_r1/kernel/drivers/mbb_common/Kconfig
```kconfig
config MBB_COMMON
	bool "MBB_COMMON Support"
	default y
	help
	  Say Y to enable Linux MBB_COMMON support.  This allows the E5 is 
	  supporting mbb_common driver.
```

## vender/modem/system/android/android_4.2_r1/kernel/drivers/modem/dialup_hsuart/Kconfig
```kconfig
#
# Balong dialup hsuart driver configuration
#

comment "m2m hsuart driver"

config M2M_HSUART
	tristate "m2m hsuart"
	default n
	help
		m2m hsuart
		
	
```

## vender/modem/system/android/android_4.2_r1/kernel/drivers/wlan_if/Kconfig
```kconfig
#
# WLAN subsystem configuration
#


config WLAN_IF
	bool "wlan interface"
	help
	      wlan interface
```
